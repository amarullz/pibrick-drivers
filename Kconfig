## Kconfig
```kconfig
# SPDX-License-Identifier: GPL-3.0-or-later

menu "piBrick CM5 Drivers"

config PIBRICK_DRIVERS
	bool "piBrick CM5 drivers"
	default y
	help
	  Enable the piBrick CM5 hardware drivers.

	  This driver collection provides support for the piBrick
	  display panel, battery, charger and touchscreen hardware.

if PIBRICK_DRIVERS

config PIBRICK_PANEL
	tristate "piBrick AMOLED panel driver"
	default m
	help
	  Enable the piBrick AMOLED panel driver.

	  Supports the piBrick 3.92-inch and 5.48-inch AMOLED
	  display panels.

config PIBRICK_BATTERY
	tristate "piBrick battery driver"
	default m
	help
	  Enable the piBrick battery and fuel-gauge driver.

	  The driver uses the MAX17048 fuel gauge when available
	  and provides the piBrick battery power_supply interface.

config PIBRICK_CHARGER
	tristate "piBrick charger driver"
	default m
	help
	  Enable the piBrick BQ25890 charger driver.

config PIBRICK_MMA8451
	tristate "piBrick MMA8451 accelerometer"
	depends on I2C
	depends on IIO
	help
	  Say Y or M here to enable support for the NXP MMA8451QR1
	  3-axis accelerometer used by the piBrick PocketCM5.

	  The driver exposes the accelerometer through the Linux IIO
	  subsystem and supports the MMA8451's 14-bit X, Y and Z
	  acceleration data.

	  This driver is intended for the piBrick PocketCM5 and uses
	  the Device Tree compatible string:

	    pibrick,mma8451

	  If unsure, say M.

source "touch/hyn_ts/Kconfig"

endif # PIBRICK_DRIVERS

endmenu
```

## touch/hyn_ts/Kconfig
```kconfig
# SPDX-License-Identifier: GPL-3.0-or-later
config HYN_TS
	tristate "Hynitron touchscreen driver"
	default m
	help
	  Hynitron touchscreen driver used by piBrick.
```
